/dts-v1/;
/plugin/;

#include "kalama-sde-display-rb5-gen2-single-wingmate.dtsi"

/ {
	model = "Qualcomm Technologies, Inc. Kalamap HDK RB5 Gen2 Single Wingmate";
	compatible = "qcom,kalamap-iot", "qcom,kalamap", "qcom,iot";
	qcom,msm-id = <603 0x20000>, <604 0x20000>;
	qcom,board-id = <0x1001f 0x4>;
};
