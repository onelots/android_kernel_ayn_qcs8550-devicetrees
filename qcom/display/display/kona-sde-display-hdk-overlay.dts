/dts-v1/;
/plugin/;

#include "kona-sde.dtsi"
#include "kona-sde-display-hdk.dtsi"

/ {
	model = "Qualcomm Technologies, Inc. kona HDK";
	compatible = "qcom,kona-hdk", "qcom,kona", "qcom,hdk";
	qcom,board-id = <0x01001f 0x01>;
};
