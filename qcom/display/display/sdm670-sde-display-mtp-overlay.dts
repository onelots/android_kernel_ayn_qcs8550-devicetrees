/dts-v1/;
/plugin/;

#include "sdm670-sde-display-mtp.dtsi"
/ {
	model = "Qualcomm Technologies, Inc. QCS605 PM660 + PM660L MTP";
	compatible = "qcom,qcs605-mtp", "qcom,qcs605", "qcom,mtp";
	qcom,msm-id = <347 0x0>;
	qcom,board-id = <8 0>,
			<8 1>;
	qcom,pmic-id =  <0x0001001b 0x0101011a 0x0 0x0>,
			<0x0001001b 0x0102001a 0x0 0x0>,
			<0x0001001b 0x0201011a 0x0 0x0>;
};
