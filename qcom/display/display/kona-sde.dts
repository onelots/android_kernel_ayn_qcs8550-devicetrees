/dts-v1/;
/plugin/;

#include "kona-sde.dtsi"

/{
	qcom,msm-id = <481 0x0>, <481 0x10000>, <481 0x20000>, <481 0x20001>,
			<548 0x20001>, <455 0x0>, <496 0x0>, <598 0x0>, <599 0x0>;
	qcom,board-id = <0 0>;
};
