/dts-v1/;
/plugin/;

#include "kalama-sde-display-aim300.dtsi"

/ {
	model = "Qualcomm Technologies, Inc. Kalama AIM300";
	compatible = "qcom,kalama-hdk", "qcom,kalama", "qcom,hdk",
			"qcom,kalamap";
	qcom,msm-id = <603 0x20000>;
	qcom,board-id = <0x1001f 0x3>;
};
