/dts-v1/;
/plugin/;

#include "kalama-audio-rb5-gen2-dvt.dtsi"
/ {
	model = "Qualcomm Technologies, Inc. Kalamap RB5 gen2 DVT";
	compatible = "qcom,kalamap-iot", "qcom,kalamap", "qcom,iot";
	qcom,msm-id = <603 0x20000>;
	qcom,board-id = <0x1011f 0x2>, <0x01001f 0x04>, <0x01001f 0x05>;
};
