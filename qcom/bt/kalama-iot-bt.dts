/dts-v1/;
/plugin/;

#include "kalama-iot-bt.dtsi"

/ {
       model = "Qualcomm Technologies, Inc. Kalama IOT SoCs";
       compatible = "qcom,kalama", "qcom,kalamap";
       qcom,msm-id = <603 0x20000>, <604 0x20000>, <668 0x20000>;
       qcom,board-id = <0 0>;
};
