/dts-v1/;
/plugin/;

#include <dt-bindings/clock/qcom,gcc-kalama.h>
#include <dt-bindings/clock/qcom,camcc-kalama.h>
#include <dt-bindings/interconnect/qcom,kalama.h>
#include <dt-bindings/interrupt-controller/arm-gic.h>
#include <dt-bindings/regulator/qcom,rpmh-regulator-levels.h>

#include "kalama-camera-sensor-iot-vc.dtsi"
/ {
	model = "Qualcomm Technologies, Inc. KalamaP IoT VC";
	compatible = "qcom,kalamap-iot", "qcom,kalamap", "qcom,iot";
	qcom,msm-id = <603 0x20000>;
	qcom,board-id = <0x10020 1>;
};
