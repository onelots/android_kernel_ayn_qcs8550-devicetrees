#include "kalamap-ayn-odin2-common.dtsi"

&chosen {
	bootargs = "console=ttyMSM0,115200n8 loglevel=6 kpti=0 log_buf_len=256K kernel.panic_on_rcu_stall=1 service_locator.enable=1 msm_rtb.filter=0x237 rcupdate.rcu_expedited=1 rcu_nocbs=0-7 ftrace_dump_on_oops swiotlb=noforce loop.max_part=7 fw_devlink.strict=1 allow_mismatched_32bit_el0 cpufreq.default_governor=performance printk.console_no_auto_verbose=1 kasan=off sysctl.kernel.sched_pelt_multiplier=4 can.stats_timer=0 pcie_ports=compat irqaffinity=0-2 disable_dma32=on no-steal-acc cgroup.memory=nokmem,nosocket slub_debug=- msm_drm.dsi_display0=qcom,dsi_xm91080_1080p_video: msm_drm.dsi_display1=qcom,mdss_dsi_ext_bridge_1080p:";
	stdout-path = "/soc/qcom,qupv3_1_geni_se@ac0000/qcom,qup_uart@a9c000";
};

&sdhc_2 {
	cd-debounce-delay-ms = <1000>;
};

&qupv3_se0_i2c {
	#address-cells = <1>;
	#size-cells = <0>;
	status = "ok";

	miniled@46 {
		compatible = "ayn,miniled";
		reg = <0x46>;
		vcc_1v2-supply = <&L11B>; 
		vcc_3v3-supply = <&BOB2>; 
	};
};