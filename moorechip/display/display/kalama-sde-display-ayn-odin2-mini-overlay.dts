/dts-v1/;
/plugin/;

#include "kalama-sde-display-ayn-odin2-mini.dtsi"

/ {
	model = "Ayn Odin 2 Mini";
	compatible = "qcom,kalama-hdk", "qcom,kalama", "qcom,hdk",
			"qcom,kalamap";
	qcom,msm-id = <603 0x20000>;
	qcom,board-id = <0x1001f 0>;
};
