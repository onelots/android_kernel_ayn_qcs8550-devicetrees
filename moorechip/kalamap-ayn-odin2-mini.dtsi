#include "kalamap-moorechip-common.dtsi"

&qupv3_se0_i2c {
	#address-cells = <1>;
	#size-cells = <0>;
	status = "ok";

	miniled@46 {
		compatible = "ayn,miniled";
		reg = <0x46>;
		vcc_1v2-supply = <&L11B>; 
		vcc_3v3-supply = <&BOB2>; 
	};
};

&joystick {
	moorechip,layout-xbox;
};